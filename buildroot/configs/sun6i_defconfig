## buildroot/fs/ext4/Config.in
```kconfig
config BR2_TARGET_ROOTFS_EXT4
	bool "ext4 root filesystem"
	help
	  Build an ext4 root filesystem

config BR2_TARGET_ROOTFS_EXT4_BLOCKS
	int "size in blocks (leave at 0 for auto calculation)"
	depends on BR2_TARGET_ROOTFS_EXT4
	default 0

config BR2_TARGET_ROOTFS_EXT4_INODES
	int "inodes (leave at 0 for auto calculation)"
	depends on BR2_TARGET_ROOTFS_EXT4
	default 0

config BR2_TARGET_ROOTFS_EXT4_RESBLKS
	int "reserved blocks percentage"
	depends on BR2_TARGET_ROOTFS_EXT4
	default 0
```

## buildroot/package/ext4-utils/Config.in
```kconfig
config BR2_PACKAGE_EXT4_UTILS
	bool "ext4 utils"
	depends on BR2_PACKAGE_ZLIB
	help
	  Ext4 utils from android
```

## buildroot/package/fuse-exfat/Config.in
```kconfig
config BR2_PACKAGE_FUSE_EXFAT
	bool "fuse-exfat"
	depends on BR2_PACKAGE_LIBFUSE
	help
	  fuse-exfat (Free exFAT file system implementation)

	  http://code.google.com/p/exfat/

comment "fuse-exfat requires libfuse support"
        depends on BR2_PACKAGE_LIBFUSE
```

## buildroot/package/kernel-header/Config.in
```kconfig
config BR2_KERNEL_HEADER
       bool "kernel header"
       help
         kernel header
```

## buildroot/package/lcd-test/Config.in
```kconfig
config BR2_PACKAGE_LCD_TEST
       bool "lcd-test"
       help
         Some test program for LCD
```

## buildroot/package/mali-3d-r2p3/Config.in
```kconfig
config BR2_PACKAGE_MALI_3D_R2P3
       bool "mali 3d(r2p3)"
       help
         Mali 3d
```

## buildroot/package/pvr-utils/Config.in
```kconfig
config BR2_PACKAGE_PVR_UTILS
  bool "pvr-utils"
  help 
  pvr-utils is an userspace services and a set of test programs for pvr-gpu drivers
```

## buildroot/package/sw-tools/Config.in
```kconfig
config BR2_PACKAGE_SW_TOOLS
       bool "sw-tools"
       depends on BR2_KERNEL_HEADER
       help
         Some useful tools from sw
```

## buildroot/package/szrz/Config.in
```kconfig
config BR2_PACKAGE_SZ_RZ
	bool "sz_rz"
	help
		rzsz-3.48 is a tool which can transport
		file with console
```

## buildroot/package/tp-test/Config.in
```kconfig
config BR2_PACKAGE_TP_TEST
       bool "tp-test"
       help
         Some test program for touchscreen
```

## linux-3.10/drivers/usb/sunxi_usb/Kconfig
```kconfig
#
# softwinner SUNXI USB2.0 Controller Driver.
#

#---------------------------------------------
#-
#- config USB2.0 Controller.
#-
#---------------------------------------------
menuconfig USB_SUNXI
    boolean "SUNXI USB support"
    depends on ARCH_SUNXI
		
if USB_SUNXI
menuconfig USB_SUNXI_USB
    tristate "SUNXI USB2.0 Dual Role Controller support"
    help
        SUNXI USB2.0 Dual Role Controller

if USB_SUNXI_USB
config USB_SUNXI_USBC
    tristate "SUNXI USB2.0 core"
    help
        usb controller core driver.
        
config USB_SUNXI_USB_MANAGER
    tristate "SUNXI USB2.0 Manager"
    depends on USB_SUNXI_USBC
    default n
    help
        manager all usb controller.
        
config USB_SUNXI_HCD0
    tristate "SUNXI otg host"
    depends on USB_SUNXI_USBC
    default y
    help
        usb otg host controller driver.
        
config USB_SUNXI_USB0_OTG
    boolean "otg support"
    depends on USB_SUNXI_HCD0
    default y
    help
        usb0 can only use for device and host.        


config USB_SUNXI_USB_DEBUG
    tristate "SUNXI USB driver debug message"
    depends on USB_SUNXI_USBC
    default n
    help
        SUNXI USB driver debug message.

config USB_SUNXI_USB_ADB
    tristate "SUNXI USB driver use adb source"
    depends on USB_SUNXI_USBC
    default n
    help
        SUNXI USB driver debug message.
endif # USB_SUNXI_USB      	
endif # USB_SUNXI
```

## linux-3.10/drivers/video/sunxi/Kconfig
```kconfig
#
# Video configuration for sunxi platform
#

menu "Video support for sunxi"
	depends on FB

config SUNIV_FB
        tristate "DISP Driver Support(suniv)"
        depends on ARCH_SUNIV
        ---help---
        default m

config  SUNXI_BOOT_COLORBAR
        bool "Show color bar when disp module registed(sunxi)"
        depends on ARCH_SUNIV && SUNIV_FB
        ---help---
        default y

config SUNIV_LCD
        tristate "LCD Driver Support(suniv)"
        depends on ARCH_SUNIV
        ---help---
        default m

config SUNIV_HDMI
        tristate "HDMI Driver Support(suniv)"
        depends on ARCH_SUNIV
        ---help---
        default m

endmenu
```
